AUTOSAR XML (schema 00046)
package /SR_Interface
  sender receiver interface Lidar_Object
    data Object_Distance: type=uint16, init-value=10
    data Object_ID: type=uint16, init-value=0
    data Object_Angle: type=uint16, init-value=0
  sensor actuator sw component type Sensor_Actuator_SWC
    provide port P_Port_Lidar: provided-interface=Lidar_Object
  application sw component type Lidar_App
    require port R_Port_Lidar: required-interface=Lidar_Object
