AUTOSAR XML (schema 00046)
package /CS_Interface
  client server interface CS_Interface_Sum
    operation Sum
      arg IN2: type=uint16, direction=IN
      arg IN2: type=uint16, direction=IN
      arg OUT: type=uint32, direction=OUT
  application sw component type Server_SWC1
    provide port PP_Server_Sum: client-server-annotation=CS_Interface_Sum
  application sw component type Client_SWC2
    require port RP_C_Sum: client-server-annotation=CS_Interface_Sum
