AUTOSAR XML (schema 00046)
standard types defined: uint8
package /datatypes
  physical dimension distance_meter: length-exp=1
  unit meter: factor-si-to-unit=1, physical-dimension=distance_meter
  compu method comp_distance: identical; unit meter
  app type my_meter: category=VALUE, compu-method=/datatypes/
  application array data type data_array: category=ARRAY
    element array_element: category=VALUE, type=my_meter, array-size-semantics=FIXED-SIZE, max-number-of-elements=5
  application record data type data_record
    application record element element1: type=my_meter
  application record data type data_record
    application record element element2: type=my_meter
  base type my_sint8: category=FIXED_LENGTH, base-type-size=8, base-type-encoding=2C, mem-alignment=8, native-declaration=char
  base type my_uint8: category=FIXED_LENGTH, base-type-size=8, base-type-encoding=NONE, native-declaration=unsigned char
  range dc_uint8: phys 8..255, raw 8..255
  data type mapping set adt_idt_mapping: data-type-map{application-data-type=my_meter, implementation-data-type=uint8}
